/*
 * Copyright (c) 2023 bytes at work AG
 * Copyritht (c) 2025 Philippe Peurichard <p.peurichard@gmail.com>

 * SPDX-License-Identifier: Apache-2.0
 */

&sdram1 {
	/* Frame buffer memory when cached causes screen flickering. */
	//zephyr,memory-attr = <DT_MEM_ARM(ATTR_MPU_RAM_NOCACHE)>;
};

&zephyr_lcd_controller {
	status = "okay";
	ext-sdram = <&sdram1>;
	def-back-color-red = <0>;
	def-back-color-green = <0>;
	def-back-color-blue = <0>;
};


&zephyr_mipi_dsi {
	status = "okay";

	/* DSI HOST dedicated PLL
	 * F_VCO = CLK_IN / pll-idf * 2 * pll-ndiv
	 * PHI = F_VCO / 2 / (1 << pll-odf) = lane_byte_clk
	 *     = 8 MHz / 2 * 2 * 125 / 2 / (1<<0) / 8 = 62.5 MHz
	 */
	pll-ndiv = <125>; // 125
	pll-idf = <2>; // 2
	pll-odf = <0>; // 1

	// test-pattern = <0>; //for testing purpose

	vs-active-high;
	hs-active-high;
	de-active-high;
};


